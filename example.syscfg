/**
 * @cliArgs --device "AM243x_ALX_beta" --package "ALX" --part "ALX" --context "r5fss0-0" --product "MCU_PLUS_SDK@07.03.01"
 * @versions {"data":"2021040816","timestamp":"2021040816","tool":"1.8.1+1900","templates":null}
 */

/**
 * Import the modules used in this configuration.
 */
const gpio       = scripting.addModule("/drivers/gpio/gpio", {}, false);
const gpio1      = gpio.addInstance();
const pruicss    = scripting.addModule("/drivers/pruicss/pruicss", {}, false);
const pruicss1   = pruicss.addInstance();
const debug_log  = scripting.addModule("/kernel/dpl/debug_log");
const mpu_armv7  = scripting.addModule("/kernel/dpl/mpu_armv7", {}, false);
const mpu_armv71 = mpu_armv7.addInstance();
const mpu_armv72 = mpu_armv7.addInstance();
const mpu_armv73 = mpu_armv7.addInstance();
const mpu_armv74 = mpu_armv7.addInstance();
const mpu_armv76 = mpu_armv7.addInstance();
const mpu_armv77 = mpu_armv7.addInstance();
const enet_cpsw  = scripting.addModule("/networking/enet_cpsw/enet_cpsw", {}, false);
const enet_cpsw1 = enet_cpsw.addInstance();

/**
 * Write custom configuration values to the imported modules.
 */
gpio1.$name                = "CONFIG_GPIO0";
gpio1.pinDir               = "OUTPUT";
gpio1.GPIO.gpioPin.$assign = "AA11";

pruicss1.$name = "CONFIG_PRU_ICSS0";

debug_log.enableUartLog        = true;
debug_log.enableCssLog         = false;
debug_log.uartLog.$name        = "CONFIG_UART0";
debug_log.uartLog.UART.$assign = "USART0";

mpu_armv71.$name             = "CONFIG_MPU_REGION0";
mpu_armv71.size              = 31;
mpu_armv71.attributes        = "Device";
mpu_armv71.accessPermissions = "Supervisor RD+WR, User RD";
mpu_armv71.allowExecute      = false;

mpu_armv72.$name             = "CONFIG_MPU_REGION1";
mpu_armv72.size              = 15;
mpu_armv72.accessPermissions = "Supervisor RD+WR, User RD";

mpu_armv73.$name             = "CONFIG_MPU_REGION2";
mpu_armv73.baseAddr          = 0x41010000;
mpu_armv73.size              = 15;
mpu_armv73.accessPermissions = "Supervisor RD+WR, User RD";

mpu_armv74.$name             = "CONFIG_MPU_REGION3";
mpu_armv74.accessPermissions = "Supervisor RD+WR, User RD";
mpu_armv74.baseAddr          = 0x70000000;
mpu_armv74.size              = 23;

mpu_armv76.$name             = "CONFIG_MPU_REGION5";
mpu_armv76.accessPermissions = "Supervisor RD+WR, User RD";
mpu_armv76.baseAddr          = 0xA5000000;
mpu_armv76.size              = 23;
mpu_armv76.attributes        = "NonCached";

mpu_armv77.$name    = "CONFIG_MPU_REGION6";
mpu_armv77.size     = 27;
mpu_armv77.baseAddr = 0x60000000;

enet_cpsw1.$name                 = "CONFIG_ENET_CPSW0";
enet_cpsw1.phyToMacInterfaceMode = "RGMII";
enet_cpsw1.phyAddr1               = 3;
enet_cpsw1.phyAddr2               = 15;
enet_cpsw1.MDIO.$assign          = "MDIO0";
enet_cpsw1.MDIO.MDC.$assign      = "W1";
enet_cpsw1.MDIO.MDIO.$assign     = "V2";
enet_cpsw1.RGMII.$assign         = "RGMII1";
enet_cpsw1.RGMII.RD0.$assign     = "T5";
enet_cpsw1.RGMII.RD1.$assign     = "R2";
enet_cpsw1.RGMII.RD2.$assign     = "U2";
enet_cpsw1.RGMII.RD3.$assign     = "T1";
enet_cpsw1.RGMII.RX_CTL.$assign  = "Y3";
enet_cpsw1.RGMII.RXC.$assign     = "U1";
enet_cpsw1.RGMII.TD0.$assign     = "Y14";
enet_cpsw1.RGMII.TD1.$assign     = "Y16";
enet_cpsw1.RGMII.TD2.$assign     = "U13";
enet_cpsw1.RGMII.TD3.$assign     = "AA14";
enet_cpsw1.RGMII.TX_CTL.$assign  = "W16";
enet_cpsw1.RGMII.TXC.$assign     = "W13";

/**
 * Pinmux solution for unlocked pins/peripherals. This ensures that minor changes to the automatic solver in a future
 * version of the tool will not impact the pinmux you originally saw.  These lines can be completely deleted in order to
 * re-solve from scratch.
 */
gpio1.GPIO.$suggestSolution                 = "GPIO0";
debug_log.uartLog.UART.RXD.$suggestSolution = "B10";
debug_log.uartLog.UART.TXD.$suggestSolution = "B11";
